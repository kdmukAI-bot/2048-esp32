## boards/waveshare_p4_lcd35/sdkconfig.defaults
```kconfig
# Board: Waveshare ESP32-P4 WiFi6 Touch LCD 3.5
# SoC-specific settings (flash, PSRAM, CPU)

# Flash: 16MB QIO @ 80MHz
CONFIG_ESPTOOLPY_FLASHMODE_QIO=y
CONFIG_ESPTOOLPY_FLASHFREQ_80M=y
CONFIG_ESPTOOLPY_FLASHSIZE_16MB=y

# PSRAM: 32MB @ 200MHz (P4 supports higher PSRAM speeds)
CONFIG_SPIRAM=y
CONFIG_SPIRAM_MEMTEST=y
CONFIG_SPIRAM_IGNORE_NOTFOUND=n

# Performance: 400 MHz CPU + -O2 optimization
CONFIG_COMPILER_OPTIMIZATION_PERF=y
```

## boards/waveshare_s3_lcd35b/sdkconfig.defaults
```kconfig
# Board: Waveshare ESP32-S3 Touch LCD 3.5B
# SoC-specific settings (flash, PSRAM, CPU)

# Flash: 16MB QIO @ 80MHz
CONFIG_ESPTOOLPY_FLASHMODE_QIO=y
CONFIG_ESPTOOLPY_FLASHFREQ_80M=y
CONFIG_ESPTOOLPY_FLASHSIZE_16MB=y

# PSRAM: Octal 8MB @ 80MHz
CONFIG_SPIRAM_MODE_OCT=y
CONFIG_SPIRAM_TYPE_AUTO=y
CONFIG_SPIRAM_SPEED_80M=y
CONFIG_SPIRAM=y
CONFIG_SPIRAM_MEMTEST=y
CONFIG_SPIRAM_IGNORE_NOTFOUND=n

# Performance: 240 MHz CPU + -O2 optimization
CONFIG_ESP_DEFAULT_CPU_FREQ_MHZ_240=y
CONFIG_COMPILER_OPTIMIZATION_PERF=y
```

## sdkconfig.defaults
```kconfig
# Shared settings for all ESP32 boards

# Network/BT disabled — not needed for a game
CONFIG_ESP_WIFI_ENABLED=n
CONFIG_BT_ENABLED=n
CONFIG_BT_NIMBLE_ENABLED=n
CONFIG_BT_BLUEDROID_ENABLED=n

# LVGL fonts (Montserrat 20/24/28 for tile numbers)
CONFIG_LV_FONT_MONTSERRAT_20=y
CONFIG_LV_FONT_MONTSERRAT_24=y
CONFIG_LV_FONT_MONTSERRAT_28=y
CONFIG_LV_FONT_MONTSERRAT_30=y

# LVGL perf monitor (shows FPS + CPU% on screen)
# Enable for debugging: set both to y
CONFIG_LV_USE_SYSMON=n
CONFIG_LV_USE_PERF_MONITOR=n
# CONFIG_LV_PERF_MONITOR_ALIGN_BOTTOM_LEFT=y

# LVGL misc
CONFIG_LV_USE_CANVAS=y
CONFIG_LV_FONT_MONTSERRAT_14=y

# Custom partition table
CONFIG_PARTITION_TABLE_CUSTOM=y
CONFIG_PARTITION_TABLE_CUSTOM_FILENAME="partitions.csv"
CONFIG_PARTITION_TABLE_FILENAME="partitions.csv"

# Task watchdog — 10s timeout (default 5s can trip during display flush)
CONFIG_ESP_TASK_WDT_TIMEOUT_S=10


# Disable error string lookup to save flash
CONFIG_ESP_ERR_TO_NAME_LOOKUP=n
```
